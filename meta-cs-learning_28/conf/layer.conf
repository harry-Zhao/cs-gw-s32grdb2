## meta-cs-learning_28/conf/layer.conf
```bitbake
# We have a conf and classes directory, add to BBPATH
BBPATH .= ":${LAYERDIR}"

# We have recipes-* directories, add to BBFILES
BBFILES += "${LAYERDIR}/recipes-*/*/*.bb \
            ${LAYERDIR}/recipes-*/*/*.bbappend"

BBFILE_COLLECTIONS += "meta-cs-learning_28"
BBFILE_PATTERN_meta-cs-learning_28 = "^${LAYERDIR}/"
BBFILE_PRIORITY_meta-cs-learning_28 = "9"

LAYERDEPENDS_meta-cs-learning_28 = "core"
LAYERSERIES_COMPAT_meta-cs-learning_28 = "gatesgarth"
```

## meta-cs-learning_31/conf/layer.conf
```bitbake
# We have a conf and classes directory, add to BBPATH
BBPATH .= ":${LAYERDIR}"

# We have recipes-* directories, add to BBFILES
BBFILES += "${LAYERDIR}/recipes-*/*/*.bb \
            ${LAYERDIR}/recipes-*/*/*.bbappend"

BBFILE_COLLECTIONS += "meta-cs-learning_31"
BBFILE_PATTERN_meta-cs-learning_31 = "^${LAYERDIR}/"
BBFILE_PRIORITY_meta-cs-learning_31 = "6"

LAYERDEPENDS_meta-cs-learning_31 = "core"
LAYERSERIES_COMPAT_meta-cs-learning_31 = "gatesgarth"
```

## meta-cs-learning_33/conf/layer.conf
```bitbake
# We have a conf and classes directory, add to BBPATH
BBPATH .= ":${LAYERDIR}"

# We have recipes-* directories, add to BBFILES
BBFILES += "${LAYERDIR}/recipes-*/*/*.bb \
            ${LAYERDIR}/recipes-*/*/*.bbappend"

BBFILE_COLLECTIONS += "meta-cs-learning_33"
BBFILE_PATTERN_meta-cs-learning_33 = "^${LAYERDIR}/"
BBFILE_PRIORITY_meta-cs-learning_33 = "6"

LAYERDEPENDS_meta-cs-learning_33 = "core"
LAYERSERIES_COMPAT_meta-cs-learning_33 = "gatesgarth"
```
